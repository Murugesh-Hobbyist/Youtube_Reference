[Variables]

;Large Launcher Buttons====================

LLT1=Chrome
;Program Name
LLP1=C:\Program Files (x86)\Google\Chrome\Application\chrome.exe
;Program Path
;LLI1=C:\Program Files (x86)\Google\Chrome\Application\31.0.1650.57\chrome.dll
;Program Icon

LLT2=Vuze Torrent
LLP2=C:\Program Files\Vuze\Azureus.exe
;LLI2=C:\Users\Dael\Documents\Rainmeter\Skins\Avengers\@Resources\Images\Icons\Steam.png

LLT3=VLC Player
LLP3=C:\Program Files (x86)\VideoLAN\VLC\vlc.exe
;LLI3=C:\Users\Dael\Documents\Rainmeter\Skins\Avengers\@Resources\Images\Icons\iTunes.png

LLT4=iTunes
LLP4=C:\Program Files (x86)\iTunes\iTunes.exe
;LLI4=C:\Users\Dael\Documents\Rainmeter\Skins\Avengers\@Resources\Images\Icons\Gamefire.png

LLT5=Verizon 4G
LLP5=C:\Program Files (x86)\Verizon Wireless\VZAccess Manager\VZAccess Manager.exe
;LLI5=C:\Users\Dael\Documents\Rainmeter\Skins\Avengers\@Resources\Images\Icons\arduino.png

LLT6=RDP
LLP6=C:\Windows\System32\mstsc.exe
;LLI6=C:\Users\Dael\Documents\Rainmeter\Skins\Avengers\@Resources\Images\Icons\Firefox.png

;Small Launcher Buttons===========================

SLT1=Notepad
SLP1=C:\Windows\System32\notepad.exe
;SLI1=C:\Users\Dael\Documents\Rainmeter\Skins\Avengers\@Resources\Images\Icons\Photoshop2.png

SLT2=Brickcom
SLP2=C:\Program Files (x86)\Brickcom\EasyConfig\EasyConfig.exe
;SLI2=C:\Users\Dael\Documents\Rainmeter\Skins\Avengers\@Resources\Images\Icons\Illustrator.png

SLT3=inSSIDer
SLP3=C:\Program Files (x86)\MetaGeek\inSSIDer 3\inSSIDer.exe
;SLI3=C:\Users\Dael\Documents\Rainmeter\Skins\Avengers\@Resources\Images\Icons\Premiere.png

SLT4=GoTo Assist
SLP4=C:\Users\Brian\AppData\Local\Citrix\GoToAssist Remote Support Expert\545\g2ax_start.exe
;SLI4=C:\Users\Dael\Documents\Rainmeter\Skins\Avengers\@Resources\Images\Icons\AfterEffects.png

SLT5=I.E.
SLP5=C:\Program Files\Internet Explorer\iexplore.exe
;SLI5=C:\Users\Dael\Documents\Rainmeter\Skins\Avengers\@Resources\Images\Icons\Audition.png

SLT6=ConnectWise
SLP6=C:\Program Files\ConnectWise\PSA.net\ConnectWise.exe
;SLI6=C:\Users\Dael\Documents\Rainmeter\Skins\Avengers\@Resources\Images\Icons\MediaEncoder.png

;Folder Launcher BUttons=========================

FLP1=C:\Users\Brian\Downloads
;Folder Path
FLN1=Downloads
;Folder Name

FLP2=C:\Users\Brian\Documents\Tech Talk
FLN2=Tech Talk

FLP3=C:\Users\Brian\Music
FLN3=Music

FLP4=C:\Users\Brian\Documents\Rainmeter
FLN4=Rainmeter

FLP5=C:\Users\Brian\Videos
FLN5=Videos

FLP6=C:\Users\Brian\Pictures
FLN6=Pictures

FLP7=C:\Users\Brian\Documents
FLN7=Documents

;Clock Webpages==============================

WN1=Facebook
;Webpage Name
WA1=https:\\facebook.com
;Webpage Address

WN2=Fark
WA2=http:\\www.fark.com

WN3=Autotask
WA3=http:\\www.autotask.net

WN4=SlashDot
WA4=http:\\www.slashdot.org

WN5=Private Email
WA5=http:\\gmail.com

WN6=Office Mail
WA6=http:\\email.legacyr.com

;Misc======================

player=cad
Drive=C:


