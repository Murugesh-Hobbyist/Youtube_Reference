[Variables]

;-----------------------
; LAYOUT

Stylesheet=Enigma Dark

;-----------------------
; GENERAL

Note1Path=#@#User\Notes\Notes.txt
Note2Path=#@#User\Notes\Tasks.txt
Note3Path=#@#User\Notes\About.txt
NoteHeight=200
Drive1=C
Drive2=E
Drive3=F
NetworkMaxDownload=1000000
NetworkMaxUpload=500000
SystemGraphType=Floating
CalendarEventFile=#@#User\Calendars\Holidays.xml
CalendarShowEvents=1
CalendarExtraDays=1
CalendarLeadingZeroes=0
CalendarMondays=0
GalleryPath=%USERPROFILE%\Pictures
GallerySubfolders=1
GalleryPosition=Center
GalleryRatio=3/4
VolumeIncrement=5
TriptychInterval=30
TriptychDisabled=0
ProcessInterval=5

;-----------------------
; MUSIC

MusicPlayerType=13
MusicPlayer=CAD

;-----------------------
; FEEDS

Feed1=http://news.google.com/news?pz=1&ned=us&hl=en&topic=h&num=10&output=rss
Feed2=http://rainmeter.net/forum/feed.php
Feed3=http://kaelri.com/feed/
GmailUsername=brianrschott
GmailPassword=2Gr3atful
FacebookFeed=https://www.facebook.com/feeds/notifications.php?id=1719924288&viewer=1719924288&key=AWjK8h2b8_COK9gz&format=rss20
GoogleCalendar1=YourCalendarAddressHere
GoogleCalendar2=YourCalendarAddressHere
GoogleCalendar3=YourCalendarAddressHere
GoogleCalendarWriteEvents=1
RTMusername=YourUserNameHere
RTMpassword=YourPasswordHere
RTMlist1=YourListNumberHere
RTMlist2=YourListNumberHere
RTMlist3=YourListNumberHere
TwitterUsername=YourUsernameHere
TwitterPassword=YourPasswordHere

;-----------------------
; WORLD

WeatherCode=2402292
WeatherCodeName=Fargo
WeatherCodeLat=46.875912
WeatherCodeLon=-96.781761
Unit=f
World1WeatherCode=44418
World1WeatherCodeName=London
World1WeatherCodeLat=51.51
World1WeatherCodeLon=-0.13
World2WeatherCode=1118370
World2WeatherCodeName=Tokyo
World2WeatherCodeLat=35.670479
World2WeatherCodeLon=139.740921
World3WeatherCode=12478500
World3WeatherCodeName=Ibiza
World3WeatherCodeLat=38.974579
World3WeatherCodeLon=1.417470

;-----------------------
; APPS

App1=Chrome
App1Path=chrome.exe
App1PathHandle=chrome.exe
App1Label=WEB
App1Icon=#@#Images\Launcher\Chrome.#ColorImage#.png
App2=Notepad
App2Path=notepad.exe
App2PathHandle=notepad.exe
App2Label=TEXT
App2Icon=#@#Images\Launcher\Text.#ColorImage#.png
App3=Explorer
App3Path=explorer.exe
App3PathHandle=explorer.exe
App3Label=FILES
App3Icon=#@#Images\Launcher\Start.#ColorImage#.png
App4=Skype
App4Path=C:\Program Files\Skype\Phone\skype.exe
App4PathHandle=skype.exe
App4Label=CHAT
App4Icon=#@#Images\Launcher\Skype.#ColorImage#.png
App5=Rainmeter.net
App5Path=http://rainmeter.net/
App5Handle=rainmeter.exe
App5Label=FORUM
App5Icon=#@#Images\Launcher\Rainmeter.png

;-----------------------
; SEARCH

Search1=Google
Search1Command="http://google.com/search?q=$UserInput$"
Search1Icon=#@#Images\Search\Google.#ColorImage#.png
Search2=Wikipedia
Search2Command="http://en.wikipedia.org/wiki/$UserInput$"
Search2Icon=#@#Images\Search\Wiki.#ColorImage#.png
Search3=YouTube
Search3Command="http://www.youtube.com/results?search_query=$UserInput$"
Search3Icon=#@#Images\Search\YouTube.#ColorImage#.png
Search4=Twitter
Search4Command="https://twitter.com/#!/search/$UserInput$"
Search4Icon=#@#Images\Search\Twitter.#ColorImage#.png
Search5=Rainmeter.net
Search5Command="https://www.google.com/search?q=site%3Ahttp%3A%2F%2Frainmeter.net%2Fcms%2F%20$UserInput$"
Search5Icon=#@#Images\Search\Run.#ColorImage#.png
