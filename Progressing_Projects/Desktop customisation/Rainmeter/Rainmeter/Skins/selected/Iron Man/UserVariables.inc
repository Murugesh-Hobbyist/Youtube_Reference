[Variables]
app1name=value1
app2name=value2
app3name=value3
app4name=value4
app5name=value5

app1path=value6
app2path=value7
app3path=value8
app4path=value9
app5path=value10

folder1path=value11
folder2path=value12
folder3path=value13
folder4path=value14
folder5path=value15
folder6path=value16

folder1name=value17
folder2name=value18
folder3name=value19
folder4name=value20
folder5name=value21
folder6name=value22

site1name=value23
site2name=value24
site3name=value25
site4name=value26
site5name=value27
site6name=value28
site7name=value29

site1link=value30
site2link=value31
site3link=value32
site4link=value33
site5link=value34
site6link=value35
site7link=value36

slideshowpath=value37

location=value38

metric=value39

drive=value40

